## package/attractmode/Config.in
```kconfig
config BR2_PACKAGE_ATTRACTMODE
	bool "attractmode"
	select BR2_PACKAGE_SFML
	select BR2_PACKAGE_FFMPEG
	select BR2_PACKAGE_FFMPEG_SWSCALE
	select BR2_PACKAGE_DEJAVU
	help
	  A graphical front-end for command line emulators that hides
	  the underlying operating system and is intended to be
	  controlled with a joystick or gamepad.

	  https://github.com/mickelson/attract
```

## package/libretro-beetle-ngp/Config.in
```kconfig
config BR2_PACKAGE_LIBRETRO_BEETLE_NGP
	bool "libretro-beetle-ngp"
	depends on BR2_PACKAGE_RETROARCH
	help
	  Libretro implementation of Beetle-NGP (NeoGeo Pocket, NeoGeo Color)

	  https://github.com/libretro/beetle-ngp-libretro
```

## package/libretro-fba/Config.in
```kconfig
config BR2_PACKAGE_LIBRETRO_FBA
	bool "libretro-fba"
	depends on BR2_PACKAGE_RETROARCH
	help
	  Libretro implementation of Final Burn Alpha (NeoGeo, Mame)

	  https://github.com/libretro/fbalpha
```

## package/libretro-gambatte/Config.in
```kconfig
config BR2_PACKAGE_LIBRETRO_GAMBATTE
	bool "libretro-gambatte"
	depends on BR2_PACKAGE_RETROARCH
	help
	  Libretro implementation of gambatte (GB, GBC)

	  https://github.com/libretro/gambatte-libretro
```

## package/libretro-genesisplusgx/Config.in
```kconfig
config BR2_PACKAGE_LIBRETRO_GENESISPLUSGX
	bool "libretro-genesisplusgx"
	depends on BR2_PACKAGE_RETROARCH
	help
	  Libretro implementation of Genesis Plus GX (GameGear)

	  https://github.com/libretro/Genesis-Plus-GX
```

## package/libretro-glupen64/Config.in
```kconfig
config BR2_PACKAGE_LIBRETRO_GLUPEN64
	bool "libretro-glupen64"
	depends on BR2_PACKAGE_RETROARCH
	help
	  Libretro implementation of Mupen64Plus+GLideN64 (N64)

	  https://github.com/loganmc10/GLupeN64
```

## package/libretro-gpsp/Config.in
```kconfig
config BR2_PACKAGE_LIBRETRO_GPSP
	bool "libretro-gpsp"
	depends on BR2_PACKAGE_RETROARCH
	help
	  Libretro implementation of gpSP (GBA)

	  https://github.com/libretro/gpsp
```

## package/libretro-nestopia/Config.in
```kconfig
config BR2_PACKAGE_LIBRETRO_NESTOPIA
	bool "libretro-nestopia"
	depends on BR2_PACKAGE_RETROARCH
	help
	  Libretro implementation of Nestopia (NES)

	  https://github.com/libretro/nestopia
```

## package/libretro-pcsx-rearmed/Config.in
```kconfig
config BR2_PACKAGE_LIBRETRO_PCSX_REARMED
	bool "libretro-pcsx-rearmed"
	depends on BR2_PACKAGE_RETROARCH
	help
	  Libretro implementation of PCSX-ReARMed (PSX)

	  https://github.com/libretro/pcsx_rearmed
```

## package/libretro-picodrive/Config.in
```kconfig
config BR2_PACKAGE_LIBRETRO_PICODRIVE
	bool "libretro-picodrive"
	depends on BR2_PACKAGE_RETROARCH
	help
	  Libretro implementation of PicoDrive (Master System, Megadrive)

	  https://github.com/libretro/picodrive
```

## package/libretro-pocketsnes/Config.in
```kconfig
config BR2_PACKAGE_LIBRETRO_POCKETSNES
	bool "libretro-pocketsnes"
	depends on BR2_PACKAGE_RETROARCH
	help
	  Libretro implementation of PocketSNES (SNES)

	  https://github.com/libretro/snes9x2002
```

## package/libretro/Config.in
```kconfig
config BR2_PACKAGE_LIBRETRO_PLATFORM
    string "Libretro Platform"

source package/libretro/retroarch/Config.in
source package/libretro/libretro-beetle-ngp/Config.in
source package/libretro/libretro-fba/Config.in
source package/libretro/libretro-gambatte/Config.in
source package/libretro/libretro-genesisplusgx/Config.in
source package/libretro/libretro-gpsp/Config.in
source package/libretro/libretro-nestopia/Config.in
source package/libretro/libretro-pcsx-rearmed/Config.in
source package/libretro/libretro-pocketsnes/Config.in
```

## package/libretro/libretro-beetle-ngp/Config.in
```kconfig
config BR2_PACKAGE_LIBRETRO_BEETLE_NGP
	bool "libretro-beetle-ngp"
	depends on BR2_PACKAGE_RETROARCH
	help
        Standalone port of Mednafen NGP to the libretro API, itself a fork of Neopop.
```

## package/libretro/libretro-fba/Config.in
```kconfig
config BR2_PACKAGE_LIBRETRO_FBA
	bool "libretro-fba"
	depends on BR2_PACKAGE_RETROARCH
    help
        Port of Final Burn Alpha to Libretro (v0.2.97.38).
```

## package/libretro/libretro-gambatte/Config.in
```kconfig
config BR2_PACKAGE_LIBRETRO_GAMBATTE
	bool "libretro-gambatte"
	depends on BR2_PACKAGE_RETROARCH
    help
        libretro implementation of libgambatte

        http://sourceforge.net/projects/gambatte
```

## package/libretro/libretro-genesisplusgx/Config.in
```kconfig
config BR2_PACKAGE_LIBRETRO_GENESISPLUSGX
	bool "libretro-genesisplusgx"
	depends on BR2_PACKAGE_RETROARCH
    help
        An enhanced port of Genesis Plus - accurate & portable Sega 8/16 bit emulator
```

## package/libretro/libretro-gpsp/Config.in
```kconfig
config BR2_PACKAGE_LIBRETRO_GPSP
	bool "libretro-gpsp"
	depends on BR2_PACKAGE_RETROARCH
    help
        gpSP for libretro.
```

## package/libretro/libretro-nestopia/Config.in
```kconfig
config BR2_PACKAGE_LIBRETRO_NESTOPIA
	bool "libretro-nestopia"
	depends on BR2_PACKAGE_RETROARCH
    help
        Enhanced version of Nestopia for Linux, BSD, and Windows
```

## package/libretro/libretro-pcsx-rearmed/Config.in
```kconfig
config BR2_PACKAGE_LIBRETRO_PCSX_REARMED
	bool "libretro-pcsx-rearmed"
	depends on BR2_PACKAGE_RETROARCH
    help
        ARM optimized PCSX fork
```

## package/libretro/libretro-pocketsnes/Config.in
```kconfig
config BR2_PACKAGE_LIBRETRO_POCKETSNES
	bool "libretro-pocketsnes"
	depends on BR2_PACKAGE_RETROARCH
    help
        Snes9x 2002. Port of SNES9x 1.39 for libretro (was previously called PocketSNES). Heavily optimized for ARM.
```

## package/libretro/retroarch/Config.in
```kconfig
config BR2_PACKAGE_RETROARCH
	bool "retroarch"
    select BR2_PACKAGE_ALSA_LIB
	help
	  Cross-platform, sophisticated frontend for the libretro API.

	  http://www.libretro.com
```

## package/mupen64plus/Config.in
```kconfig
source package/mupen64plus/mupen64plus-core/Config.in
source package/mupen64plus/mupen64plus-rsp-hle/Config.in
source package/mupen64plus/mupen64plus-input-sdl/Config.in
source package/mupen64plus/mupen64plus-audio-sdl/Config.in
source package/mupen64plus/mupen64plus-video-glide64mk2/Config.in
source package/mupen64plus/mupen64plus-video-gliden64/Config.in
source package/mupen64plus/mupen64plus-video-rice/Config.in
source package/mupen64plus/mupen64plus-ui-console/Config.in
```

## package/mupen64plus/mupen64plus-audio-sdl/Config.in
```kconfig
config BR2_PACKAGE_MUPEN64PLUS_AUDIO_SDL
	bool "mupen64plus-audio-sdl"
	depends on BR2_PACKAGE_MUPEN64PLUS_CORE
	help
        Audio plugin for the Mupen64Plus v2.0 project, using SDL. This plugin
        is based on the original jttl_audio plugin in Mupen64.
```

## package/mupen64plus/mupen64plus-core/Config.in
```kconfig
config BR2_PACKAGE_MUPEN64PLUS_CORE
	bool "mupen64plus-core"
    select BR2_PACKAGE_ZLIB
    select BR2_PACKAGE_LIBPNG
    select BR2_PACKAGE_SDL2
	help
        Core module of the Mupen64Plus project
```

## package/mupen64plus/mupen64plus-input-sdl/Config.in
```kconfig
config BR2_PACKAGE_MUPEN64PLUS_INPUT_SDL
	bool "mupen64plus-input-sdl"
	depends on BR2_PACKAGE_MUPEN64PLUS_CORE
	help
        Input plugin for Mupen64Plus v2.0 project using SDL. This is derived
        from the original Mupen64 blight_input plugin.
```
