## package/mupen64plus/mupen64plus-rsp-hle/Config.in
```kconfig
config BR2_PACKAGE_MUPEN64PLUS_RSP_HLE
	bool "mupen64plus-rsp-hle"
	depends on BR2_PACKAGE_MUPEN64PLUS_CORE
	help
        RSP processor plugin for the Mupen64Plus v2.0 project. This plugin is
        based on the Mupen64 HLE RSP plugin v0.2 with Azimers code by Hacktarux
```

## package/mupen64plus/mupen64plus-ui-console/Config.in
```kconfig
config BR2_PACKAGE_MUPEN64PLUS_UI_CONSOLE
	bool "mupen64plus-ui-console"
	depends on BR2_PACKAGE_MUPEN64PLUS_CORE
	help
        Console (command-line) front-end user interface for Mupen64Plus v2.0 project
```

## package/mupen64plus/mupen64plus-video-glide64mk2/Config.in
```kconfig
config BR2_PACKAGE_MUPEN64PLUS_VIDEO_GLIDE64MK2
	bool "mupen64plus-video-glide64mk2"
	depends on BR2_PACKAGE_MUPEN64PLUS_CORE
    select BR2_PACKAGE_BOOST
    select BR2_PACKAGE_BOOST_FILESYSTEM
    help 
        Video plugin for Mupen64Plus 2.0 based on 10th anniversary release code
        from gonetz
```

## package/mupen64plus/mupen64plus-video-gliden64/Config.in
```kconfig
config BR2_PACKAGE_MUPEN64PLUS_VIDEO_GLIDEN64
	bool "mupen64plus-video-gliden64"
	depends on BR2_PACKAGE_MUPEN64PLUS_CORE
    select BR2_PACKAGE_FREETYPE
	help
        A new generation, open-source graphics plugin for N64 emulators.
```

## package/mupen64plus/mupen64plus-video-rice/Config.in
```kconfig
config BR2_PACKAGE_MUPEN64PLUS_VIDEO_RICE
	bool "mupen64plus-video-rice"
	depends on BR2_PACKAGE_MUPEN64PLUS_CORE
    help 
        Video plugin for the Mupen64Plus v2.0 project, using OpenGL. This
        plugin is based on the RiceVideoLinux plugin from earlier versions of
        Mupen64Plus.
```

## package/retroarch/Config.in
```kconfig
config BR2_PACKAGE_RETROARCH
	bool "retroarch"
	depends on BR2_PACKAGE_ZLIB
	help
	  Cross-platform, sophisticated frontend for the libretro API.

	  http://www.libretro.com
```

## package/sfml-pi/Config.in
```kconfig
config BR2_PACKAGE_SFML_PI
	bool "sfml-pi"
	depends on BR2_PACKAGE_HAS_UDEV
	depends on BR2_PACKAGE_RPI_USERLAND
	select BR2_PACKAGE_JPEG
	select BR2_PACKAGE_OPENAL
	select BR2_PACKAGE_FLAC
	select BR2_PACKAGE_LIBVORBIS
	select BR2_PACKAGE_FREETYPE
	help
	  SFML for the Raspberry Pi (w/ hardware accelerated graphics
	  and no X dependency)

	  http://github.com/mickelson/sfml-pi
```

## package/sfml/Config.in
```kconfig
config BR2_PACKAGE_SFML
	bool "sfml"
	depends on BR2_PACKAGE_HAS_UDEV
    select BR2_PACKAGE_JPEG
    select BR2_PACKAGE_OPENAL
    select BR2_PACKAGE_FLAC
    select BR2_PACKAGE_LIBVORBIS
    select BR2_PACKAGE_FREETYPE
	help
        Simple and Fast Multimedia Library
```
